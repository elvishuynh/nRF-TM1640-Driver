## CMakeLists.txt
```
cmake_minimum_required(VERSION 3.20.0)

list(APPEND ZEPHYR_EXTRA_MODULES ${CMAKE_CURRENT_SOURCE_DIR}/../tm1640_module)

find_package(Zephyr REQUIRED HINTS $ENV{ZEPHYR_BASE})
project(xiao_ble_nrf52840_tm1640_app)
target_sources(app PRIVATE src/main.c)
```

## sysbuild.conf
```
# Enable MCUboot
SB_CONFIG_BOOTLOADER_MCUBOOT=y

# Disable NSIB to cut overhead
SB_CONFIG_SECURE_BOOT_APPCORE=n

# Overwrite-only upgrade mode (no swap partition)
SB_CONFIG_MCUBOOT_MODE_OVERWRITE_ONLY=y

# Skip signature verification (use SHA256 only for speed)
SB_CONFIG_BOOT_SIGNATURE_TYPE_NONE=y

# Disable Partition Manager, use DTS partitions instead
SB_CONFIG_PARTITION_MANAGER=n
```

## prj.conf
```kconfig
CONFIG_GPIO=y

CONFIG_FLASH=y
CONFIG_FLASH_MAP=y
CONFIG_STREAM_FLASH=y

CONFIG_IMG_MANAGER=y
CONFIG_MCUBOOT_IMG_MANAGER=y

CONFIG_TM1640=y
CONFIG_TM1640_INVERT_ROWS=n
CONFIG_TM1640_REVERSE_COLUMNS=n

CONFIG_CONSOLE=y
CONFIG_USE_SEGGER_RTT=y
CONFIG_RTT_CONSOLE=y

CONFIG_LOG=y
CONFIG_LOG_DEFAULT_LEVEL=3
```

## boards/xiao_ble_nrf52840_sense.overlay
```dts
#include "../dts/partitions.dtsi"

/ {
    chosen {
        zephyr,code-partition = &slot0_partition;
    };
};

/ {
    tm1640: tm1640 {
        compatible = "titanmec,tm1640";
        status = "okay";
        din-gpios = <&gpio0 2 GPIO_ACTIVE_HIGH>; /* D0 */
        clk-gpios = <&gpio0 3 GPIO_ACTIVE_HIGH>; /* D1 */
    };
};
```

## src/main.c
```c
/*
 * Copyright (c) 2025
 * SPDX-License-Identifier: Apache-2.0
 *
 * Scrolling "Hello World" demo for the TM1640.
 */

#include <zephyr/kernel.h>
#include <zephyr/device.h>
#include <zephyr/devicetree.h>
#include <zephyr/logging/log.h>
#include <string.h>

#include <drivers/display/tm1640.h>
#include <drivers/display/tm1640_text.h>

LOG_MODULE_REGISTER(tm1640_demo, LOG_LEVEL_DBG);

#define SCROLL_DELAY_MS 80
#define SCROLL_MSG      "Hello World"

/* strlen * stride gives total pixel width; start offscreen right, end offscreen left */
#define SCROLL_START    TM1640_LOGICAL_COLUMNS
#define SCROLL_END      (-(int)(sizeof(SCROLL_MSG) - 1) * 6)

int main(void)
{
	const struct device *dev = DEVICE_DT_GET(DT_NODELABEL(tm1640));

	if (!device_is_ready(dev)) {
		LOG_ERR("TM1640 not ready");
		return -1;
	}

	LOG_INF("TM1640 scroll demo started");

	tm1640_clear(dev);
	tm1640_set_brightness(dev, 1);
	tm1640_display_on(dev);

	while (1) {
		for (int off = SCROLL_START; off >= SCROLL_END; off--) {
			tm1640_print(dev, SCROLL_MSG, off);
			k_msleep(SCROLL_DELAY_MS);
		}
	}

	return 0;
}
```
