## tm1640_module/Kconfig
```kconfig
config TM1640
	bool "TM1640 LED Matrix Display Driver"
	default n
	depends on GPIO
	help
	  Enable driver for the Titan Micro Electronics TM1640 LED matrix
	  display controller. Uses bit-banged GPIO for the custom dual-line
	  serial protocol (CLK + DIN). Supports 16 segments × 8 bits with
	  8-level PWM brightness control.

config TM1640_INVERT_ROWS
	bool "Invert LED matrix rows"
	depends on TM1640
	default n
	help
	  Enable this if the LED matrix is wired with SEG8 at the top.

config TM1640_REVERSE_COLUMNS
	bool "Reverse LED matrix column order"
	depends on TM1640
	default n
	help
	  Enable this if GRID1 is on the right side of the display.
```

## tm1640_module/dts/bindings/titanmec,tm1640.yaml
```yaml
description: |
  Titan Micro Electronics TM1640 LED Matrix Display Controller.
  Uses a custom dual-line serial interface (CLK + DIN) driven via
  bit-banged GPIO. Supports 16 segments × 8 bits with 8-level
  brightness control.

compatible: "titanmec,tm1640"

properties:
  din-gpios:
    type: phandle-array
    required: true
    description: GPIO pin connected to the TM1640 DIN (data input) line.

  clk-gpios:
    type: phandle-array
    required: true
    description: GPIO pin connected to the TM1640 CLK (serial clock) line.
```
